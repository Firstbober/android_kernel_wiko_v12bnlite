/* Copyright (c) 2015-2016, The Linux Foundation. All rights reserved.
 *
 * This program is free software; you can redistribute it and/or modify
 * it under the terms of the GNU General Public License version 2 and
 * only version 2 as published by the Free Software Foundation.
 *
 * This program is distributed in the hope that it will be useful,
 * but WITHOUT ANY WARRANTY; without even the implied warranty of
 * MERCHANTABILITY or FITNESS FOR A PARTICULAR PURPOSE.  See the
 * GNU General Public License for more details.
 */

&mdss_mdp {
	dsi_icn9706_720_1440_vid: qcom,mdss_dsi_icn9706_720_1440p_video {
		qcom,mdss-dsi-panel-name = "icn9706 720 1440p video mode dsi panel";
		qcom,mdss-dsi-panel-controller = <&mdss_dsi0>;
		qcom,mdss-dsi-panel-destination = "display_1";
		qcom,mdss-dsi-panel-type = "dsi_video_mode";
		qcom,mdss-dsi-panel-framerate = <60>;
		qcom,mdss-dsi-virtual-channel-id = <0>;
		qcom,mdss-dsi-stream = <0>;
		qcom,mdss-dsi-panel-width = <720>;
		qcom,mdss-dsi-panel-height = <1440>;
		qcom,mdss-dsi-h-front-porch = <84>;
		qcom,mdss-dsi-h-back-porch = <84>;
		qcom,mdss-dsi-h-pulse-width = <24>;
		qcom,mdss-dsi-h-sync-skew = <0>;
		qcom,mdss-dsi-v-back-porch = <20>;
		qcom,mdss-dsi-v-front-porch = <24>;
		qcom,mdss-dsi-v-pulse-width = <8>;
		qcom,mdss-dsi-h-left-border = <0>;
		qcom,mdss-dsi-h-right-border = <0>;
		qcom,mdss-dsi-v-top-border = <0>;
		qcom,mdss-dsi-v-bottom-border = <0>;
		qcom,mdss-dsi-bpp = <24>;
		qcom,mdss-dsi-underflow-color = <0xff>;
		qcom,mdss-dsi-border-color = <0>;
		qcom,mdss-dsi-h-sync-pulse = <1>;
		qcom,mdss-dsi-traffic-mode = "burst_mode";
		qcom,mdss-dsi-bllp-eof-power-mode;
		qcom,mdss-dsi-bllp-power-mode;
		qcom,mdss-dsi-lane-map = "lane_map_0123";	
		qcom,mdss-dsi-lane-0-state;
		qcom,mdss-dsi-lane-1-state;
		qcom,mdss-dsi-lane-2-state;
		qcom,mdss-dsi-lane-3-state;
		qcom,mdss-dsi-panel-timings = [8B 1E 14 00 44 48 18 22 19 03 04 00];
		qcom,mdss-dsi-t-clk-post = <0x04>;
		qcom,mdss-dsi-t-clk-pre = <0x1c>;
		
		qcom,mdss-dsi-bl-min-level = <1>;
		qcom,mdss-dsi-bl-max-level = <4095>;
		qcom,mdss-dsi-dma-trigger = "trigger_sw";
		qcom,mdss-dsi-mdp-trigger = "none";
		qcom,mdss-dsi-on-command = [39 01 00 00 64 00 02 01 00
			39 01 00 00 00 00 03 F0 5A 5A
			39 01 00 00 00 00 03 F1 5A 5A
			39 01 00 00 00 00 03 F0 B4 4B
			39 01 00 00 00 00 03 B6 10 10
			39 01 00 00 00 00 15 B4 0A 08 12 10 0E 0C 00 00 00 03 00 03 03 03 03 03 03 03 04 06
			39 01 00 00 00 00 15 B3 0B 09 13 11 0F 0D 00 00 00 03 00 03 03 03 03 03 03 03 05 07
			39 01 00 00 00 00 0D B0 54 32 23 45 44 44 44 44 60 01 60 01
			39 01 00 00 00 00 09 B1 32 84 02 83 15 01 57 01
			39 01 00 00 00 00 02 B2 33
			39 01 00 00 00 00 07 BD 54 14 6a 6a 20 19
			39 01 00 00 00 00 12 B7 01 01 09 11 0D 15 19 0D 21 1D 00 00 20 00 02 FF 3C
			39 01 00 00 00 00 06 B8 23 01 30 34 53
			39 01 00 00 00 00 05 B9 A1 2C FF C4
			39 01 00 00 00 00 03 BA 88 23
			39 01 00 00 00 00 07 C1 16 16 04 0C 10 04
			39 01 00 00 00 00 03 C2 12 68
			39 01 00 00 00 00 04 C3 22 31 04
			39 01 00 00 00 00 06 C7 05 23 6B 41 00
			39 01 00 00 00 00 27 C8 7C 54 3D 2D 26 16 1B 08 25 28 2D 4F 3E 48 3D 3D 35 25 06 7C 54 3D 2D 26 16 1B 08 25 28 2D 4F 3E 48 3D 3D 35 25 06
			39 01 00 00 00 00 09 C6 00 00 68 00 00 60 36 00
			05 01 00 00 64 00 02 11 00
			05 01 00 00 32 00 02 29 00];

		qcom,mdss-dsi-off-command = [05 01 00 00 32 00 02 28 00
			05 01 00 00 32 00 02 10 00];
		
		qcom,mdss-dsi-on-command-state = "dsi_lp_mode";
		qcom,mdss-dsi-off-command-state = "dsi_lp_mode";
		
		qcom,esd-check-enabled;
		qcom,mdss-dsi-panel-status-check-mode = "bta_check";
//		qcom,mdss-dsi-panel-status-command = [06 01 00 01 05 00 02 0A 08];
//		qcom,mdss-dsi-panel-status-command-state = "dsi_hs_mode";
//		qcom,mdss-dsi-panel-status-check-mode = "reg_read";
//		qcom,mdss-dsi-panel-status-read-length = <1>;
//		qcom,mdss-dsi-panel-status-value = <0x1c>;
		
		qcom,mdss-dsi-bl-pmic-control-type = "bl_ctrl_wled";
//		qcom,mdss-dsi-lp11-init;
		qcom,mdss-dsi-reset-sequence = <1 2>, <0 20>, <1 50>;
		qcom,mdss-dsi-tx-eot-append;
		//qcom,mdss-dsi-post-init-delay = <50>;

		qcom,mdss-pan-physical-width-dimension = <63>;
		qcom,mdss-pan-physical-height-dimension = <112>;
	};
};
