/* Copyright (c) 2015-2016, The Linux Foundation. All rights reserved.
 *
 * This program is free software; you can redistribute it and/or modify
 * it under the terms of the GNU General Public License version 2 and
 * only version 2 as published by the Free Software Foundation.
 *
 * This program is distributed in the hope that it will be useful,
 * but WITHOUT ANY WARRANTY; without even the implied warranty of
 * MERCHANTABILITY or FITNESS FOR A PARTICULAR PURPOSE.  See the
 * GNU General Public License for more details.
 */

&mdss_mdp {
	dsi_hx8394f_720_1440_vid_v11bnlite: qcom,mdss_dsi_hx8394f_720_1440p_video_v11bnlite {
		qcom,mdss-dsi-panel-name = "hx8394f 720 1440p video mode dsi panel";
		qcom,mdss-dsi-panel-controller = <&mdss_dsi0>;
		qcom,mdss-dsi-panel-destination = "display_1";
		qcom,mdss-dsi-panel-type = "dsi_video_mode";
		qcom,mdss-dsi-panel-framerate = <60>;
		qcom,mdss-dsi-virtual-channel-id = <0>;
		qcom,mdss-dsi-stream = <0>;
		qcom,mdss-dsi-panel-width = <720>;
		qcom,mdss-dsi-panel-height = <1440>;
		qcom,mdss-dsi-h-front-porch = <16>;
		qcom,mdss-dsi-h-back-porch = <16>;
		qcom,mdss-dsi-h-pulse-width = <10>;
		qcom,mdss-dsi-h-sync-skew = <0>;
		qcom,mdss-dsi-v-back-porch = <12>;
		qcom,mdss-dsi-v-front-porch = <15>;
		qcom,mdss-dsi-v-pulse-width = <4>;
		qcom,mdss-dsi-h-left-border = <0>;
		qcom,mdss-dsi-h-right-border = <0>;
		qcom,mdss-dsi-v-top-border = <0>;
		qcom,mdss-dsi-v-bottom-border = <0>;
		qcom,mdss-dsi-bpp = <24>;
		qcom,mdss-dsi-underflow-color = <0xff>;
		qcom,mdss-dsi-border-color = <0>;
		qcom,mdss-dsi-h-sync-pulse = <1>;
		qcom,mdss-dsi-traffic-mode = "burst_mode";
		qcom,mdss-dsi-bllp-eof-power-mode;
		qcom,mdss-dsi-bllp-power-mode;
		qcom,mdss-dsi-lane-map = "lane_map_0123";	
		qcom,mdss-dsi-lane-0-state;
		qcom,mdss-dsi-lane-1-state;
		qcom,mdss-dsi-lane-2-state;
		qcom,mdss-dsi-lane-3-state;
		qcom,mdss-dsi-panel-timings = [72 16 0e 00 38 3c 12 1a 10 03 04 00];
		qcom,mdss-dsi-t-clk-post = <0x04>;
		qcom,mdss-dsi-t-clk-pre = <0x1c>;
		
		qcom,mdss-dsi-bl-min-level = <1>;
		qcom,mdss-dsi-bl-max-level = <4095>;
		qcom,mdss-dsi-dma-trigger = "trigger_sw";
		qcom,mdss-dsi-mdp-trigger = "none";
		qcom,mdss-dsi-on-command = [
			39 01 00 00 00 00 04 B9 FF 83 94
			39 01 00 00 00 00 0b B1 50 11 71 09 32 44 71 51 55 30
			39 01 00 00 00 00 07 BA 63 03 68 6B B2 C0
			39 01 00 00 00 00 06 B2 00 80 78 0C 07
			39 01 00 00 00 00 16 B4 01 6B 01 6B 01 6B 01 0C 7C 75 00 3F 01 6B 01 6B 01 6B 01 0C 7C
			39 01 00 00 00 00 22 D3 00 00 00 00 3C 1C 00 00 32 10 0A 00 0A 32 15 AE 05 AE 32 00 00 00 00 27 02 0C 0C 27 00 00 00 0C 40
			39 01 00 00 00 00 2d D5 19 19 18 18 1B 1B 1A 1A 00 01 02 03 04 05 06 07 20 21 18 18 18 18 18 18 18 18 18 18 18 18 24 25 18 18 18 18 18 18 18 18 18 18 18 18
			39 01 00 00 00 00 2d D6 18 18 19 19 1B 1B 1A 1A 07 06 05 04 03 02 01 00 25 24 18 18 18 18 18 18 18 18 18 18 18 18 21 20 18 18 18 18 18 18 18 18 18 18 18 18
			39 01 00 00 00 00 3b E0 00 04 0C 12 14 18 1A 18 31 3F 4D 4C 54 65 6B 70 7F 82 7E 8A 99 4A 48 49 4B 4A 4C 4B 7F 00 04 0C 11 13 17 1A 18 31 3F 4D 4C 54 65 6B 70 7F 82 7E 8A 99 4A 48 49 4B 4A 4C 4B 7F
			39 01 00 00 00 00 02 CC 0B
			39 01 00 00 00 00 03 C0 1F 31
			39 01 00 00 00 00 03 B6 6C 6C
			39 01 00 00 00 00 02 D4 02
			39 01 00 00 00 00 02 BD 01
			39 01 00 00 00 00 02 B1 00
			39 01 00 00 00 00 02 BD 00
			39 01 00 00 00 00 08 BF 40 81 50 00 1A FC 01
			39 01 00 00 00 00 02 C6 EF
			39 01 00 00 00 00 01 35
			05 01 00 00 78 00 02 11 00
			05 01 00 00 14 00 02 29 00];

		qcom,mdss-dsi-off-command = [05 01 00 00 32 00 02 28 00
			05 01 00 00 32 00 02 10 00];
		
		qcom,mdss-dsi-on-command-state = "dsi_lp_mode";
		qcom,mdss-dsi-off-command-state = "dsi_lp_mode";
		
		qcom,esd-check-enabled;
		qcom,mdss-dsi-panel-status-check-mode = "bta_check";
//		qcom,mdss-dsi-panel-status-command = [06 01 00 01 05 00 02 0A 08];
//		qcom,mdss-dsi-panel-status-command-state = "dsi_hs_mode";
//		qcom,mdss-dsi-panel-status-check-mode = "reg_read";
//		qcom,mdss-dsi-panel-status-read-length = <1>;
//		qcom,mdss-dsi-panel-status-value = <0x1c>;
		
		qcom,mdss-dsi-bl-pmic-control-type = "bl_ctrl_wled";
//		qcom,mdss-dsi-lp11-init;
		qcom,mdss-dsi-reset-sequence = <1 20>, <0 2>, <1 20>;
		qcom,mdss-dsi-tx-eot-append;
		//qcom,mdss-dsi-post-init-delay = <50>;

		qcom,mdss-pan-physical-width-dimension = <63>;
		qcom,mdss-pan-physical-height-dimension = <112>;
	};
};

