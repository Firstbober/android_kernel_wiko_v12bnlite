
qcom,tinno-3000mah {
	/* #2650966_HYHY_I9031_3000mAh_averaged_MasterSlave_Oct24th2016*/
	qcom,max-voltage-uv = <4400000>;
	qcom,nom-batt-capacity-mah = <3000>;
	// pony.ma, DATE20161008, I9031 ID=100Kohm,else can't charge, DATE20161008-01 LINE
	qcom,batt-id-kohm = <100>;
	qcom,battery-beta = <3435>;
	qcom,battery-type = "tinno-3000mah";
	qcom,chg-rslow-comp-c1 = <2856796>;
	qcom,chg-rslow-comp-c2 = <3294975>;
	qcom,chg-rs-to-rslow = <853272>;
	qcom,chg-rslow-comp-thr = <0x99>;
	qcom,checksum = <0x42C1>;
	qcom,gui-version = "PMI8950GUI - 2.0.0.16";
	qcom,fg-profile-data = [
		 F2 83 7E 7D
		 9F 81 20 7C
		 58 83 B6 5C
		 B3 81 B9 8C
		 3A 82 D7 98
		 E2 B6 97 C2
		 5A 10 10 88
		 BB 7E 7D 82
		 EE 7C 4B 83
		 AF 71 E9 6F
		 6D 6F 5A 82
		 2E 99 49 BC
		 C5 C8 5F 0E
		 16 0C 0D 5B
		 14 70 B2 FD
		 91 3D FB 3F
		 DE 3B 00 00
		 48 47 52 28
		 27 38 00 00
		 00 00 00 00
		 00 00 00 00
		 50 6B 0B 6A
		 CC 72 5C 8A
		 52 75 24 69
		 75 5E F4 79
		 D4 6F F0 61
		 59 60 C4 A9
		 1D 4E 68 21
		 66 A0 71 0C
		 28 00 FF 36
		 F0 11 30 03
		 00 00 00 0C
	];
};
